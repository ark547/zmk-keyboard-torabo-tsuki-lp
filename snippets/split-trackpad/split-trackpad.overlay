&i2c0 {
    status = "okay";

    trackpad: trackpad@56 {
        compatible = "azoteq,iqs7211e";
        reg = <0x56>;
        irq-gpios = <&gpio0 20 GPIO_PULL_UP>;
        power-gpios = <&gpio0 8 (GPIO_ACTIVE_HIGH | NRF_GPIO_DRIVE_H1)>;
        status = "okay";
    };
};

split_inputs {
    #address-cells = <1>;
    #size-cells = <0>;

    trackpad_split: trackpad_split@0 {
        compatible = "zmk,input-split";
        reg = <0>;
        device = <&trackpad>;
        status = "okay";
    };
};
