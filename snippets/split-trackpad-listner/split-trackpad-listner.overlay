/ {
    split_inputs {
        trackpad_split_listener: trackpad_split_listener {
            compatible = "zmk,input-listener";
            device = <&trackpad_split>;
            status = "okay";
            input-processors = <&zip_xy_transform 0x03>;
        };
    };
};
